## boards/shields/dadiya_rev0/Kconfig.defconfig
```kconfig
if SHIELD_DADIYA_LEFT

# Name must be less than 16 characters long!
config ZMK_KEYBOARD_NAME
    default "DadiyaRev0"

config ZMK_SPLIT_ROLE_CENTRAL
    default y

endif

if SHIELD_DADIYA_LEFT || SHIELD_DADIYA_RIGHT

config ZMK_SPLIT
    default y

endif
```

## boards/shields/dadiya_rev0/Kconfig.shield
```kconfig
# No whitespace after the comma or in your part name!
config SHIELD_DADIYA_LEFT
    def_bool $(shields_list_contains,my_keyboard_left)

# No whitespace after the comma or in your part name!
config SHIELD_DADIYA_RIGHT
    def_bool $(shields_list_contains,my_keyboard_right)
```
